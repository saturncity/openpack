/* App-level devicetree for the receiver board (#118): the same icmsg IPC as the DK. Its host link is the uart0 header (no USB on the rack receiver), so no CDC. Pins are in the board. */
#include "ipc_icmsg_cpuapp.dtsi"
