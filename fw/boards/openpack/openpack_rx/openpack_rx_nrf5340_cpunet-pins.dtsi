/* GENERATED by fw/boards/openpack/gen_pins.py from hw/rx/out/rx.net (hw/rx/rx.py, ADR-0014). Do not edit:
 * change the schematic, rerun hw/rx/rx.py, then gen_pins.py.
 * openpack_rx/nrf5340/cpunet. tests/test_fw_board_pins.py checks it against the netlist. */

/ {
	zephyr,user {
		ant-sel-gpios = <&gpio1 1 GPIO_ACTIVE_HIGH>; /* ANT_SEL@D6 */
	};
};
