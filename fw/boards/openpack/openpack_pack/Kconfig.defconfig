## fw/boards/openpack/openpack_pack/Kconfig.defconfig
```kconfig
# OpenPack body-pack (Fanstel BT40NE) (#118)
if BOARD_OPENPACK_PACK

config HW_STACK_PROTECTION
	default ARCH_HAS_STACK_PROTECTION

endif
```

## fw/boards/openpack/openpack_pack/Kconfig.openpack_pack
```kconfig
# OpenPack body-pack (Fanstel BT40NE) (#118)
config BOARD_OPENPACK_PACK
	select SOC_NRF5340_CPUAPP_QKAA if BOARD_OPENPACK_PACK_NRF5340_CPUAPP
	select SOC_NRF5340_CPUNET_QKAA if BOARD_OPENPACK_PACK_NRF5340_CPUNET
```

## fw/boards/openpack/openpack_pack/board.yml
```yaml
board:
  name: openpack_pack
  full_name: OpenPack body-pack (Fanstel BT40NE)
  vendor: openpack
  socs:
    - name: nrf5340
```

## fw/boards/openpack/openpack_rx/board.yml
```yaml
board:
  name: openpack_rx
  full_name: OpenPack receiver sub-board (Fanstel BT40E)
  vendor: openpack
  socs:
    - name: nrf5340
```

## fw/src/rx/Kconfig
```kconfig
# Receiver net core (RX-2..RX-5). FW-5: timing constants are Kconfig.

config OP_RX_TRACK_WIN_US
	int "RX-3 tracking window: accept a copy within +- this of its expected start (us)"
	default 50

config OP_RX_MISS_LIMIT
	int "RX-3 consecutive frames with no valid copy before re-acquisition"
	default 100

config OP_RX_ANT_HYST_DB
	int "RX-5 switch when the other antenna's last-valid RSSI is this much stronger (dB)"
	default 6

config OP_RX_ANT_PROBE_FRAMES
	int "RX-5 frames between probes of the other antenna, per channel (ADR-0011, ADR-0021), 0 = never"
	default 1000
	help
	  A probe sends one copy's window to the other antenna. When that antenna can't hear the pack
	  over the Wi-Fi (wing antennas, ADR-0021), the frame rests on the other copy alone, which may be
	  the in-band one. At 100 frames that cost 0.16 % frame loss with TD off in bsim (prosc12-near2,
	  40 % Wi-Fi); at 1000 it is 0.02 %. A blocked antenna still ages out after hyst + dRSSI misses,
	  so switching away does not wait for a probe; switching back waits up to 1 s.

config OP_PACK_TEST_RUN_MS
	int "Test only: the pack stops transmitting after this many ms, 0 = never (tests/bsim/rx scenario e)"
	default 0
	help
	  Emulates a pack powering off for the pack-reboot scenario (RX-10); the reboot itself is a new
	  bsim device started with -start_offset. Never set in a shipped build.
```

## fw/src/rx_app/Kconfig
```kconfig
# Receiver app core (RX-6, RX-7, ADR-0013). FW-5: timing constants are Kconfig.

config OP_RX_SLOT_TARGET_SAMPLES
	int "RX-7 jitter slot fill at frame arrival (samples) = latency the slot adds"
	default 6
	range 1 47
	help
	  6 samples = 125 us, inside the SPEC section 2 line "decode + jitter slot 200 us". The slot
	  holds one frame of headroom above this (target + 2 frames), so a frame may arrive up to
	  target late or ~1 ms early without a slip.

config OP_RX_CLK_KP_PPB
	int "RX-7 PI loop proportional gain (ppb of DAC clock per sample of fill error)"
	default 26000

config OP_RX_CLK_KI_PPB
	int "RX-7 PI loop integral gain (ppb per sample of fill error per frame)"
	default 8

config OP_RX_CLK_LIM_PPB
	int "RX-7 correction limit (ppb), also the integrator clamp"
	default 100000
```

## tests/bsim/probe/radio/Kconfig
```kconfig
mainmenu "bsim radio probe"

config PROBE_ROLE_TX
	bool "Transmit (else receive)"

config PROBE_PACKETS
	int "Packets per carrier block, one per 1 ms"
	default 3000

source "Kconfig.zephyr"
```
