/* GENERATED by fw/boards/openpack/gen_pins.py from hw/pack/out/pack.net (hw/pack/pack.py, ADR-0012). Do not edit:
 * change the schematic, rerun hw/pack/pack.py, then gen_pins.py.
 * openpack_pack/nrf5340/cpunet. tests/test_fw_board_pins.py checks it against the netlist. */

/* BT40NE nRF21540 front-end (#107), GPIO mode. Module-internal wiring, Fanstel v1.09 p.21; the pads are
 * NC on the board (checked). ANT_SEL level for the u.FL is CONFIG_OP_FEM_ANT_SEL_UFL (unverified). */
/ {
	nrf_radio_fem: nrf21540_fem {
		compatible = "nordic,nrf21540-fem";
		tx-en-gpios = <&gpio0 21 GPIO_ACTIVE_HIGH>; /* pad C2 */
		rx-en-gpios = <&gpio0 27 GPIO_ACTIVE_HIGH>; /* pad D2 */
		pdn-gpios = <&gpio0 26 GPIO_ACTIVE_HIGH>; /* pad D1 */
		mode-gpios = <&gpio1 4 GPIO_ACTIVE_HIGH>; /* pad E0 */
		ant-sel-gpios = <&gpio1 5 GPIO_ACTIVE_HIGH>; /* pad E1 */
	};
};

&radio {
	fem = <&nrf_radio_fem>;
};
